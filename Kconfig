## Kconfig
```kconfig
menu "eKeep Compatibility Drivers"

config EKEEP_GPIO_595_COMPAT
    bool "Enable 74HC595 GPIO compatibility driver"
    depends on GPIO && SPI
    default y
    help
      Provides a local fallback implementation for zmk,gpio-595.
      This is intended for Zephyr/ZMK combinations where upstream
      CONFIG_GPIO_595 is unavailable.

config EKEEP_GPIO_595_INIT_PRIORITY
    int "74HC595 GPIO driver init priority"
    default 81
    depends on EKEEP_GPIO_595_COMPAT

endmenu
```

## boards/shields/ekeeb/Kconfig.defconfig
```kconfig
# Copyright (c) 2021 The ZMK Contributors
# SPDX-License-Identifier: MIT

if SHIELD_EKEEB

config ZMK_KEYBOARD_NAME
	default "ekeeb"

config SPI
    default y

if ZMK_DISPLAY

config I2C
	default y

config SSD1306
	default y

config SSD1306_REVERSE_MODE
	default y

endif # ZMK_DISPLAY

if LVGL

config LV_Z_VDB_SIZE
	default 64

config LV_DPI_DEF
	default 148

config LV_Z_BITS_PER_PIXEL
	default 1

config LV_COLOR_DEPTH_1
	default y

endif # LVGL

endif
```
